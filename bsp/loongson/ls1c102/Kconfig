## bsp/loongson/ls1c102/Kconfig
```kconfig
mainmenu "RT-Thread Configuration"

BSP_DIR := .

RTT_DIR := ../../..

PKGS_DIR := packages

config SOC_LS1C102
    bool
    select RT_USING_COMPONENTS_INIT
    select RT_USING_USER_MAIN
    default y

menu "SoC Peripheral Drivers"
    menuconfig BSP_USING_GBE
        bool "Enable RTL8211F"
        default n
        if BSP_USING_GBE
            config RT_USING_LWIP
                bool "LWIP"
                default n
            config RT_USING_NETDEV
                bool "netdev"
                default n
        endif
endmenu

source "$(RTT_DIR)/Kconfig"
osource "$PKGS_DIR/Kconfig"
```
